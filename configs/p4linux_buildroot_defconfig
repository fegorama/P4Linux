## configs/p4linux_buildroot_defconfig
```kconfig
# P4Linux - Buildroot configuration
# Architecture: RISC-V RV32IMAC
# Memory model: NOMMU
# Target RAM: 32 MiB

BR2_riscv=y
BR2_riscv_custom=y
BR2_RISCV_ISA_RVM=y
BR2_RISCV_ISA_RVA=y
BR2_RISCV_ISA_RVC=y
BR2_RISCV_32=y
# BR2_RISCV_USE_MMU is not set
BR2_RISCV_ABI_ILP32=y

BR2_TOOLCHAIN_BUILDROOT=y
BR2_TOOLCHAIN_BUILDROOT_UCLIBC=y
BR2_PACKAGE_HOST_LINUX_HEADERS_CUSTOM_6_18=y

BR2_STATIC_LIBS=y
BR2_BINFMT_FLAT=y

BR2_TARGET_GENERIC_HOSTNAME="p4linux"
BR2_TARGET_GENERIC_ISSUE="Welcome to P4Linux"

BR2_INIT_BUSYBOX=y
BR2_ROOTFS_DEVICE_CREATION_DYNAMIC_DEVTMPFS=y

BR2_TARGET_GENERIC_GETTY=y
BR2_TARGET_GENERIC_GETTY_PORT="ttyS0"
BR2_TARGET_GENERIC_GETTY_BAUDRATE_115200=y

BR2_PACKAGE_BUSYBOX=y
BR2_PACKAGE_BUSYBOX_CONFIG="package/busybox/busybox-minimal.config"

BR2_TARGET_ROOTFS_CPIO=y
# BR2_TARGET_ROOTFS_TAR is not set
BR2_ROOTFS_OVERLAY="../../rootfs/overlay"
```
